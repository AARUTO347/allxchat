#include "OLEDModule.h"
#include <stdarg.h>
#include <stdio.h>
#include <string.h>

// Minimal 5x7 font (ASCII 32-127), 5 bytes per glyph
static const uint8_t font5x7[][5] = {
    {0x00,0x00,0x00,0x00,0x00}, // 32 space
    {0x00,0x00,0x5F,0x00,0x00}, // 33 !
    {0x00,0x07,0x00,0x07,0x00}, // 34 "
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    {0x10,0x08,0x08,0x10,0x08}, // 126 ~
};

OLEDModule::OLEDModule(uint8_t sda, uint8_t scl, uint8_t addr)
    : sda_(sda), scl_(scl), addr_(addr) {
    memset(buffer_, 0, sizeof(buffer_));
}

void OLEDModule::beginTransmission(uint8_t ctrl) {
    Wire.beginTransmission(addr_);
    Wire.write(ctrl);
}

void OLEDModule::writeCommand(uint8_t cmd) {
    Wire.beginTransmission(addr_);
    Wire.write((uint8_t)0x00); // Command control byte
    Wire.write(cmd);
    Wire.endTransmission();
}

void OLEDModule::writeData(uint8_t data) {
    Wire.beginTransmission(addr_);
    Wire.write((uint8_t)0x40); // Data control byte
    Wire.write(data);
    Wire.endTransmission();
}

void OLEDModule::setCursor(int x, int y) {
    cursorX_ = x;
    cursorY_ = y;
}

void OLEDModule::drawChar(char c, int x, int y, int size) {
    if (c < 32 || c > 126) return;
    const uint8_t* glyph = font5x7[c - 32];
    int w = 5 * size;
    int h = 7 * size;

    for (int col = 0; col < 5; col++) {
        uint8_t colData = glyph[col];
        for (int row = 0; row < 7; row++) {
            if (colData & (1 << row)) {
                // Fill a size x size pixel block
                for (int dy = 0; dy < size; dy++) {
                    for (int dx = 0; dx < size; dx++) {
                        int px = x + col * size + dx;
                        int py = y + row * size + dy;
                        if (px >= 128 || py >= 64) continue;
                        int page = py / 8;
                        int bit = py % 8;
                        buffer_[px + page * 128] |= (1 << bit);
                    }
                }
            }
        }
    }
}

bool OLEDModule::init() {
    Wire.begin(sda_, scl_);

    // Standard SSD1306 init sequence
    uint8_t cmds[] = {
        0xAE,       // Display OFF
        0xA8, 0x3F, // Set multiplex
        0xD3, 0x00, // Display offset
        0x40,       // Start line = 0
        0xA1,       // Segment remap reversed (column addr 127->0)
        0xC8,       // COM scan direction remap
        0xDA, 0x12, // COM pins config
        0x81, 0x7F, // Contrast
        0xA4,       // Resume to RAM content
        0xA6,       // Normal display
        0xD5, 0x80, // Clock divide
        0x8D, 0x14, // Charge pump ON
        0x20, 0x00, // Memory mode = horizontal
        0xAF        // Display ON
    };
    for (size_t i = 0; i < sizeof(cmds); i++) {
        writeCommand(cmds[i]);
        delay(1);
    }

    // Test I2C presence
    Wire.beginTransmission(addr_);
    bool present = (Wire.endTransmission() == 0);

    memset(buffer_, 0, sizeof(buffer_));
    cursorX_ = 0;
    cursorY_ = 0;

    initialized_ = true;
    healthy_ = present;
    dirty_ = false;

    if (present) {
        AARUESP_DEBUG_PRINTLN("[OLED] SSD1306 OLED initialized");
    } else {
        AARUESP_DEBUG_PRINTLN("[OLED] No display detected at 0x" + String(addr_, HEX));
    }
    return present;
}

void OLEDModule::update() {
    // Nothing time-based; rendering happens via display()
}

void OLEDModule::clear() {
    memset(buffer_, 0, sizeof(buffer_));
    cursorX_ = 0;
    cursorY_ = 0;
    dirty_ = true;
}

void OLEDModule::print(int x, int y, const char* text, int size) {
    if (text == nullptr) return;
    int cx = x;
    int cy = y;
    for (const char* c = text; *c != '\0'; c++) {
        if (*c == '\n') {
            cx = x;
            cy += 8 * size;
            continue;
        }
        drawChar(*c, cx, cy, size);
        cx += (5 + 1) * size;
    }
    setCursor(cx, cy);
    dirty_ = true;
}

void OLEDModule::printP(int x, int y, const char* text, int size) {
    print(x, y, text, size);
}

void OLEDModule::display() {
    // Write buffer rows page by page
    for (int page = 0; page < 8; page++) {
        writeCommand((uint8_t)(0xB0 + page)); // Page address
        writeCommand((uint8_t)0x00);          // Lower column
        writeCommand((uint8_t)0x10);          // Upper column
        for (int col = 0; col < 128; col++) {
            writeData(buffer_[col + page * 128]);
        }
    }
    dirty_ = false;
}

void OLEDModule::println(int line, const char* format, ...) {
    char buffer[128];
    va_list args;
    va_start(args, format);
    vsnprintf(buffer, sizeof(buffer), format, args);
    va_end(args);

    print(0, line * 8, buffer, 1);
    dirty_ = true;
}

bool OLEDModule::isHealthy() const {
    return initialized_ && healthy_;
}